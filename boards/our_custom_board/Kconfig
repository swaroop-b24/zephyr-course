## boards/our_custom_board/Kconfig.defconfig
```kconfig
# Our Custom Board nRF52840 board configuration
# Copyright (c) 2016 Nordic Semiconductor ASA
# SPDX-License-Identifier: Apache-2.0

if BOARD_OUR_CUSTOM_BOARD

config HW_STACK_PROTECTION
    default ARCH_HAS_STACK_PROTECTION

if NORDIC_QSPI_NOR
config NORDIC_QSPI_NOR_FLASH_LAYOUT_PAGE_SIZE
    default 4096 if MCUBOOT || BOOTLOADER_MCUBOOT
endif # NORDIC_QSPI_NOR

endif # BOARD_OUR_CUSTOM_BOARD
```

## boards/our_custom_board/Kconfig.our_custom_board
```kconfig
config BOARD_OUR_CUSTOM_BOARD
	bool "Our Custom Board"
	select SOC_NRF52840_QIAA
	select BOARD_HAS_NRF5_BOOTLOADER
```

## boards/our_custom_board/board.yml
```yaml
board:
  name: our_custom_board
  full_name: Our Custom Board
  vendor: swaroop
  socs:
  - name: nrf52840
```

## boards/scratch_board/Kconfig.defconfig
```kconfig
# Copyright (c) 2024 Swaroop
# SPDX-License-Identifier: Apache-2.0

if BOARD_SCRATCH_BOARD

config HW_STACK_PROTECTION
	default ARCH_HAS_STACK_PROTECTION

endif # BOARD_SCRATCH_BOARD
```

## boards/scratch_board/Kconfig.scratch_board
```kconfig
# Copyright (c) 2024 Swaroop
# SPDX-License-Identifier: Apache-2.0

config BOARD_SCRATCH_BOARD
	select SOC_NRF52840_QIAA if BOARD_SCRATCH_BOARD_NRF52840
```

## boards/scratch_board/board.yml
```yaml
board:
  name: scratch_board
  full_name: Scratch Board
  vendor: swaroop
  socs:
  - name: nrf52840
```

## our-driver-module/drivers/our_driver/Kconfig
```kconfig
# Copyright (c) 2024 Swaroop 
# SPDX-License-Identifier: Apache-2.0 
 
menuconfig OUR_DRIVER 
    bool "Our Custom LED Sensor Driver" 
    default y 
    depends on DT_HAS_OUR_DRIVER_ENABLED 
    select GPIO 
    help 
      Enable the custom LED sensor driver. 
```

## our-driver-module/dts/bindings/driver/our,driver.yaml
```yaml
# Copyright (c) 2024 Swaroop
# SPDX-License-Identifier: Apache-2.0

description: Our custom LED sensor driver binding

compatible: "our,driver"

include: base.yaml

properties:
  gpios:
    type: phandle-array
    required: true
    description: GPIO pin connected to the LED
```
