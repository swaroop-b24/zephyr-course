## twister-out.2/qemu_x86_atom/zephyr_gnu/tests/ring_buf/homework.unit.ring_buf/Kconfig/soc/Kconfig.defconfig
```kconfig
# Load Zephyr SoC defconfig descriptions.
osource "F:/swaroopb_zephyr/zephyr-course/zephyr/soc/xlnx/zynqmp/Kconfig.defconfig"
osource "F:/swaroopb_zephyr/zephyr-course/zephyr/soc/xlnx/zynq7000/Kconfig.defconfig"
osource "F:/swaroopb_zephyr/zephyr-course/zephyr/soc/xlnx/versalnet/Kconfig.defconfig"
osource "F:/swaroopb_zephyr/zephyr-course/zephyr/soc/xlnx/versal2/Kconfig.defconfig"
osource "F:/swaroopb_zephyr/zephyr-course/zephyr/soc/xlnx/versal/Kconfig.defconfig"
osource "F:/swaroopb_zephyr/zephyr-course/zephyr/soc/xen/Kconfig.defconfig"
osource "F:/swaroopb_zephyr/zephyr-course/zephyr/soc/wch/ch32v/Kconfig.defconfig"
osource "F:/swaroopb_zephyr/zephyr-course/zephyr/soc/ti/simplelink/Kconfig.defconfig"
osource "F:/swaroopb_zephyr/zephyr-course/zephyr/soc/ti/mspm0/Kconfig.defconfig"
osource "F:/swaroopb_zephyr/zephyr-course/zephyr/soc/ti/lm3s6965/Kconfig.defconfig"
osource "F:/swaroopb_zephyr/zephyr-course/zephyr/soc/ti/k3/Kconfig.defconfig"
osource "F:/swaroopb_zephyr/zephyr-course/zephyr/soc/telink/tlsr/Kconfig.defconfig"
osource "F:/swaroopb_zephyr/zephyr-course/zephyr/soc/syna/sr100/Kconfig.defconfig"
osource "F:/swaroopb_zephyr/zephyr-course/zephyr/soc/starfive/jh71xx/Kconfig.defconfig"
osource "F:/swaroopb_zephyr/zephyr-course/zephyr/soc/st/stm32/Kconfig.defconfig"
osource "F:/swaroopb_zephyr/zephyr-course/zephyr/soc/snps/qemu_arc/Kconfig.defconfig"
osource "F:/swaroopb_zephyr/zephyr-course/zephyr/soc/snps/nsim/arc_v/Kconfig.defconfig"
osource "F:/swaroopb_zephyr/zephyr-course/zephyr/soc/snps/nsim/arc_classic/Kconfig.defconfig"
osource "F:/swaroopb_zephyr/zephyr-course/zephyr/soc/snps/hsdk4xd/Kconfig.defconfig"
osource "F:/swaroopb_zephyr/zephyr-course/zephyr/soc/snps/hsdk/Kconfig.defconfig"
osource "F:/swaroopb_zephyr/zephyr-course/zephyr/soc/snps/emsk/Kconfig.defconfig"
osource "F:/swaroopb_zephyr/zephyr-course/zephyr/soc/snps/emsdp/Kconfig.defconfig"
osource "F:/swaroopb_zephyr/zephyr-course/zephyr/soc/snps/arc_iot/Kconfig.defconfig"
osource "F:/swaroopb_zephyr/zephyr-course/zephyr/soc/silabs/Kconfig.defconfig"
osource "F:/swaroopb_zephyr/zephyr-course/zephyr/soc/sifli/sf32/Kconfig.defconfig"
osource "F:/swaroopb_zephyr/zephyr-course/zephyr/soc/sifive/sifive_freedom/Kconfig.defconfig"
osource "F:/swaroopb_zephyr/zephyr-course/zephyr/soc/sensry/Kconfig.defconfig"
osource "F:/swaroopb_zephyr/zephyr-course/zephyr/soc/rockchip/Kconfig.defconfig"
osource "F:/swaroopb_zephyr/zephyr-course/zephyr/soc/renode/riscv_virtual/Kconfig.defconfig"
osource "F:/swaroopb_zephyr/zephyr-course/zephyr/soc/renode/cortex_r8_virtual/Kconfig.defconfig"
osource "F:/swaroopb_zephyr/zephyr-course/zephyr/soc/renesas/smartbond/Kconfig.defconfig"
osource "F:/swaroopb_zephyr/zephyr-course/zephyr/soc/renesas/rz/Kconfig.defconfig"
osource "F:/swaroopb_zephyr/zephyr-course/zephyr/soc/renesas/rx/Kconfig.defconfig"
osource "F:/swaroopb_zephyr/zephyr-course/zephyr/soc/renesas/rcar/Kconfig.defconfig"
osource "F:/swaroopb_zephyr/zephyr-course/zephyr/soc/renesas/ra/Kconfig.defconfig"
osource "F:/swaroopb_zephyr/zephyr-course/zephyr/soc/realtek/fingerprint/Kconfig.defconfig"
osource "F:/swaroopb_zephyr/zephyr-course/zephyr/soc/realtek/ec/Kconfig.defconfig"
osource "F:/swaroopb_zephyr/zephyr-course/zephyr/soc/realtek/bee/Kconfig.defconfig"
osource "F:/swaroopb_zephyr/zephyr-course/zephyr/soc/realtek/ameba/Kconfig.defconfig"
osource "F:/swaroopb_zephyr/zephyr-course/zephyr/soc/raspberrypi/rpi_pico/Kconfig.defconfig"
osource "F:/swaroopb_zephyr/zephyr-course/zephyr/soc/quicklogic/eos_s3/Kconfig.defconfig"
osource "F:/swaroopb_zephyr/zephyr-course/zephyr/soc/qemu/virt_riscv/Kconfig.defconfig"
osource "F:/swaroopb_zephyr/zephyr-course/zephyr/soc/qemu/or1k/Kconfig.defconfig"
osource "F:/swaroopb_zephyr/zephyr-course/zephyr/soc/qemu/malta/Kconfig.defconfig"
osource "F:/swaroopb_zephyr/zephyr-course/zephyr/soc/openisa/rv32m1/Kconfig.defconfig"
osource "F:/swaroopb_zephyr/zephyr-course/zephyr/soc/openhwgroup/cva6/Kconfig.defconfig"
osource "F:/swaroopb_zephyr/zephyr-course/zephyr/soc/oct/osd32mp15x/Kconfig.defconfig"
osource "F:/swaroopb_zephyr/zephyr-course/zephyr/soc/nxp/s32/Kconfig.defconfig"
osource "F:/swaroopb_zephyr/zephyr-course/zephyr/soc/nxp/rw/Kconfig.defconfig"
osource "F:/swaroopb_zephyr/zephyr-course/zephyr/soc/nxp/mcx/Kconfig.defconfig"
osource "F:/swaroopb_zephyr/zephyr-course/zephyr/soc/nxp/lpc/Kconfig.defconfig"
osource "F:/swaroopb_zephyr/zephyr-course/zephyr/soc/nxp/layerscape/Kconfig.defconfig"
osource "F:/swaroopb_zephyr/zephyr-course/zephyr/soc/nxp/kinetis/Kconfig.defconfig"
osource "F:/swaroopb_zephyr/zephyr-course/zephyr/soc/nxp/imxrt/Kconfig.defconfig"
osource "F:/swaroopb_zephyr/zephyr-course/zephyr/soc/nxp/imx/Kconfig.defconfig"
osource "F:/swaroopb_zephyr/zephyr-course/zephyr/soc/nuvoton/numicro/Kconfig.defconfig"
osource "F:/swaroopb_zephyr/zephyr-course/zephyr/soc/nuvoton/numaker/Kconfig.defconfig"
osource "F:/swaroopb_zephyr/zephyr-course/zephyr/soc/nuvoton/npcx/Kconfig.defconfig"
osource "F:/swaroopb_zephyr/zephyr-course/zephyr/soc/nuvoton/npcm/Kconfig.defconfig"
osource "F:/swaroopb_zephyr/zephyr-course/zephyr/soc/nordic/Kconfig.defconfig"
osource "F:/swaroopb_zephyr/zephyr-course/zephyr/soc/neorv32/Kconfig.defconfig"
osource "F:/swaroopb_zephyr/zephyr-course/zephyr/soc/native/inf_clock/Kconfig.defconfig"
osource "F:/swaroopb_zephyr/zephyr-course/zephyr/soc/microchip/sam/sama7/Kconfig.defconfig"
osource "F:/swaroopb_zephyr/zephyr-course/zephyr/soc/microchip/sam/sam_d5x_e5x/Kconfig.defconfig"
osource "F:/swaroopb_zephyr/zephyr-course/zephyr/soc/microchip/pic64/Kconfig.defconfig"
osource "F:/swaroopb_zephyr/zephyr-course/zephyr/soc/microchip/pic32c/pic32cz_ca/Kconfig.defconfig"
osource "F:/swaroopb_zephyr/zephyr-course/zephyr/soc/microchip/pic32c/pic32cx_sg/Kconfig.defconfig"
osource "F:/swaroopb_zephyr/zephyr-course/zephyr/soc/microchip/pic32c/pic32cm_pl/Kconfig.defconfig"
osource "F:/swaroopb_zephyr/zephyr-course/zephyr/soc/microchip/pic32c/pic32cm_jh/Kconfig.defconfig"
osource "F:/swaroopb_zephyr/zephyr-course/zephyr/soc/microchip/miv/Kconfig.defconfig"
osource "F:/swaroopb_zephyr/zephyr-course/zephyr/soc/microchip/mec/Kconfig.defconfig"
osource "F:/swaroopb_zephyr/zephyr-course/zephyr/soc/mediatek/mt8xxx/Kconfig.defconfig"
osource "F:/swaroopb_zephyr/zephyr-course/zephyr/soc/lowrisc/opentitan/Kconfig.defconfig"
osource "F:/swaroopb_zephyr/zephyr-course/zephyr/soc/litex/litex_vexriscv/Kconfig.defconfig"
osource "F:/swaroopb_zephyr/zephyr-course/zephyr/soc/ite/ec/Kconfig.defconfig"
osource "F:/swaroopb_zephyr/zephyr-course/zephyr/soc/intel/wildcat_lake/Kconfig.defconfig"
osource "F:/swaroopb_zephyr/zephyr-course/zephyr/soc/intel/raptor_lake/Kconfig.defconfig"
osource "F:/swaroopb_zephyr/zephyr-course/zephyr/soc/intel/panther_lake/Kconfig.defconfig"
osource "F:/swaroopb_zephyr/zephyr-course/zephyr/soc/intel/lakemont/Kconfig.defconfig"
osource "F:/swaroopb_zephyr/zephyr-course/zephyr/soc/intel/intel_socfpga_std/Kconfig.defconfig"
osource "F:/swaroopb_zephyr/zephyr-course/zephyr/soc/intel/intel_socfpga/Kconfig.defconfig"
osource "F:/swaroopb_zephyr/zephyr-course/zephyr/soc/intel/intel_niosv/Kconfig.defconfig"
osource "F:/swaroopb_zephyr/zephyr-course/zephyr/soc/intel/intel_ish/Kconfig.defconfig"
osource "F:/swaroopb_zephyr/zephyr-course/zephyr/soc/intel/intel_adsp/Kconfig.defconfig"
osource "F:/swaroopb_zephyr/zephyr-course/zephyr/soc/intel/elkhart_lake/Kconfig.defconfig"
osource "F:/swaroopb_zephyr/zephyr-course/zephyr/soc/intel/atom/Kconfig.defconfig"
osource "F:/swaroopb_zephyr/zephyr-course/zephyr/soc/intel/apollo_lake/Kconfig.defconfig"
osource "F:/swaroopb_zephyr/zephyr-course/zephyr/soc/intel/alder_lake/Kconfig.defconfig"
osource "F:/swaroopb_zephyr/zephyr-course/zephyr/soc/infineon/psoc4/Kconfig.defconfig"
osource "F:/swaroopb_zephyr/zephyr-course/zephyr/soc/infineon/edge/Kconfig.defconfig"
osource "F:/swaroopb_zephyr/zephyr-course/zephyr/soc/infineon/cat3/Kconfig.defconfig"
osource "F:/swaroopb_zephyr/zephyr-course/zephyr/soc/infineon/cat1c/Kconfig.defconfig"
osource "F:/swaroopb_zephyr/zephyr-course/zephyr/soc/infineon/cat1b/Kconfig.defconfig"
osource "F:/swaroopb_zephyr/zephyr-course/zephyr/soc/infineon/cat1a/Kconfig.defconfig"
osource "F:/swaroopb_zephyr/zephyr-course/zephyr/soc/gd/gd32/Kconfig.defconfig"
osource "F:/swaroopb_zephyr/zephyr-course/zephyr/soc/gaisler/leon3/Kconfig.defconfig"
osource "F:/swaroopb_zephyr/zephyr-course/zephyr/soc/gaisler/gr716a/Kconfig.defconfig"
osource "F:/swaroopb_zephyr/zephyr-course/zephyr/soc/focaltech/Kconfig.defconfig"
osource "F:/swaroopb_zephyr/zephyr-course/zephyr/soc/espressif/Kconfig.defconfig"
osource "F:/swaroopb_zephyr/zephyr-course/zephyr/soc/ene/kb1200/Kconfig.defconfig"
osource "F:/swaroopb_zephyr/zephyr-course/zephyr/soc/ene/kb106x/Kconfig.defconfig"
osource "F:/swaroopb_zephyr/zephyr-course/zephyr/soc/elan/em32f967/Kconfig.defconfig"
osource "F:/swaroopb_zephyr/zephyr-course/zephyr/soc/egis/Kconfig.defconfig"
osource "F:/swaroopb_zephyr/zephyr-course/zephyr/soc/efinix/sapphire/Kconfig.defconfig"
osource "F:/swaroopb_zephyr/zephyr-course/zephyr/soc/cdns/xtensa_sample_controller/Kconfig.defconfig"
osource "F:/swaroopb_zephyr/zephyr-course/zephyr/soc/cdns/swerv/Kconfig.defconfig"
osource "F:/swaroopb_zephyr/zephyr-course/zephyr/soc/cdns/sample_controller32/Kconfig.defconfig"
osource "F:/swaroopb_zephyr/zephyr-course/zephyr/soc/cdns/dc233c/Kconfig.defconfig"
osource "F:/swaroopb_zephyr/zephyr-course/zephyr/soc/brcm/bcmvk/Kconfig.defconfig"
osource "F:/swaroopb_zephyr/zephyr-course/zephyr/soc/brcm/bcm2712/Kconfig.defconfig"
osource "F:/swaroopb_zephyr/zephyr-course/zephyr/soc/brcm/bcm2711/Kconfig.defconfig"
osource "F:/swaroopb_zephyr/zephyr-course/zephyr/soc/blackberry/qnxhv_vm/Kconfig.defconfig"
osource "F:/swaroopb_zephyr/zephyr-course/zephyr/soc/bflb/Kconfig.defconfig"
osource "F:/swaroopb_zephyr/zephyr-course/zephyr/soc/atmel/sam0/Kconfig.defconfig"
osource "F:/swaroopb_zephyr/zephyr-course/zephyr/soc/atmel/sam/Kconfig.defconfig"
osource "F:/swaroopb_zephyr/zephyr-course/zephyr/soc/aspeed/Kconfig.defconfig"
osource "F:/swaroopb_zephyr/zephyr-course/zephyr/soc/arm/Kconfig.defconfig"
osource "F:/swaroopb_zephyr/zephyr-course/zephyr/soc/arm/beetle/Kconfig.defconfig"
osource "F:/swaroopb_zephyr/zephyr-course/zephyr/soc/antmicro/myra/Kconfig.defconfig"
osource "F:/swaroopb_zephyr/zephyr-course/zephyr/soc/andestech/Kconfig.defconfig"
osource "F:/swaroopb_zephyr/zephyr-course/zephyr/soc/amd/acp_6_0/Kconfig.defconfig"
osource "F:/swaroopb_zephyr/zephyr-course/zephyr/soc/ambiq/Kconfig.defconfig"
osource "F:/swaroopb_zephyr/zephyr-course/zephyr/soc/allwinner/sun8i_h3/Kconfig.defconfig"
osource "F:/swaroopb_zephyr/zephyr-course/zephyr/soc/alif/ensemble/Kconfig.defconfig"
osource "F:/swaroopb_zephyr/zephyr-course/zephyr/soc/aesc/Kconfig.defconfig"
osource "F:/swaroopb_zephyr/zephyr-course/zephyr/soc/adi/max32/Kconfig.defconfig"
```
