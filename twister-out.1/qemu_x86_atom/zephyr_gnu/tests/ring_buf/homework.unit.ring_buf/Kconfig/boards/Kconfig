## twister-out.1/qemu_x86_atom/zephyr_gnu/tests/ring_buf/homework.unit.ring_buf/Kconfig/boards/Kconfig
```kconfig
# Load Zephyr board Kconfig descriptions.
osource "F:/swaroopb_zephyr/zephyr-course/zephyr/boards/qemu/x86/Kconfig"
```

## twister-out.2/qemu_x86_atom/zephyr_gnu/tests/ring_buf/homework.unit.ring_buf/Kconfig/soc/Kconfig
```kconfig
# Load Zephyr SoC Kconfig descriptions.
osource "F:/swaroopb_zephyr/zephyr-course/zephyr/soc/xlnx/zynqmp/Kconfig"
osource "F:/swaroopb_zephyr/zephyr-course/zephyr/soc/xlnx/zynq7000/Kconfig"
osource "F:/swaroopb_zephyr/zephyr-course/zephyr/soc/xlnx/versalnet/Kconfig"
osource "F:/swaroopb_zephyr/zephyr-course/zephyr/soc/xlnx/versal2/Kconfig"
osource "F:/swaroopb_zephyr/zephyr-course/zephyr/soc/xlnx/versal/Kconfig"
osource "F:/swaroopb_zephyr/zephyr-course/zephyr/soc/xen/Kconfig"
osource "F:/swaroopb_zephyr/zephyr-course/zephyr/soc/wch/ch32v/Kconfig"
osource "F:/swaroopb_zephyr/zephyr-course/zephyr/soc/ti/simplelink/Kconfig"
osource "F:/swaroopb_zephyr/zephyr-course/zephyr/soc/ti/mspm0/Kconfig"
osource "F:/swaroopb_zephyr/zephyr-course/zephyr/soc/ti/lm3s6965/Kconfig"
osource "F:/swaroopb_zephyr/zephyr-course/zephyr/soc/ti/k3/Kconfig"
osource "F:/swaroopb_zephyr/zephyr-course/zephyr/soc/telink/tlsr/Kconfig"
osource "F:/swaroopb_zephyr/zephyr-course/zephyr/soc/syna/sr100/Kconfig"
osource "F:/swaroopb_zephyr/zephyr-course/zephyr/soc/starfive/jh71xx/Kconfig"
osource "F:/swaroopb_zephyr/zephyr-course/zephyr/soc/st/stm32/Kconfig"
osource "F:/swaroopb_zephyr/zephyr-course/zephyr/soc/snps/qemu_arc/Kconfig"
osource "F:/swaroopb_zephyr/zephyr-course/zephyr/soc/snps/nsim/arc_v/Kconfig"
osource "F:/swaroopb_zephyr/zephyr-course/zephyr/soc/snps/nsim/arc_classic/Kconfig"
osource "F:/swaroopb_zephyr/zephyr-course/zephyr/soc/snps/hsdk4xd/Kconfig"
osource "F:/swaroopb_zephyr/zephyr-course/zephyr/soc/snps/hsdk/Kconfig"
osource "F:/swaroopb_zephyr/zephyr-course/zephyr/soc/snps/emsk/Kconfig"
osource "F:/swaroopb_zephyr/zephyr-course/zephyr/soc/snps/emsdp/Kconfig"
osource "F:/swaroopb_zephyr/zephyr-course/zephyr/soc/snps/arc_iot/Kconfig"
osource "F:/swaroopb_zephyr/zephyr-course/zephyr/soc/silabs/Kconfig"
osource "F:/swaroopb_zephyr/zephyr-course/zephyr/soc/sifli/sf32/Kconfig"
osource "F:/swaroopb_zephyr/zephyr-course/zephyr/soc/sifive/sifive_freedom/Kconfig"
osource "F:/swaroopb_zephyr/zephyr-course/zephyr/soc/sensry/Kconfig"
osource "F:/swaroopb_zephyr/zephyr-course/zephyr/soc/rockchip/Kconfig"
osource "F:/swaroopb_zephyr/zephyr-course/zephyr/soc/renode/riscv_virtual/Kconfig"
osource "F:/swaroopb_zephyr/zephyr-course/zephyr/soc/renode/cortex_r8_virtual/Kconfig"
osource "F:/swaroopb_zephyr/zephyr-course/zephyr/soc/renesas/smartbond/Kconfig"
osource "F:/swaroopb_zephyr/zephyr-course/zephyr/soc/renesas/rz/Kconfig"
osource "F:/swaroopb_zephyr/zephyr-course/zephyr/soc/renesas/rx/Kconfig"
osource "F:/swaroopb_zephyr/zephyr-course/zephyr/soc/renesas/rcar/Kconfig"
osource "F:/swaroopb_zephyr/zephyr-course/zephyr/soc/renesas/ra/Kconfig"
osource "F:/swaroopb_zephyr/zephyr-course/zephyr/soc/realtek/fingerprint/Kconfig"
osource "F:/swaroopb_zephyr/zephyr-course/zephyr/soc/realtek/ec/Kconfig"
osource "F:/swaroopb_zephyr/zephyr-course/zephyr/soc/realtek/bee/Kconfig"
osource "F:/swaroopb_zephyr/zephyr-course/zephyr/soc/realtek/ameba/Kconfig"
osource "F:/swaroopb_zephyr/zephyr-course/zephyr/soc/raspberrypi/rpi_pico/Kconfig"
osource "F:/swaroopb_zephyr/zephyr-course/zephyr/soc/quicklogic/eos_s3/Kconfig"
osource "F:/swaroopb_zephyr/zephyr-course/zephyr/soc/qemu/virt_riscv/Kconfig"
osource "F:/swaroopb_zephyr/zephyr-course/zephyr/soc/qemu/or1k/Kconfig"
osource "F:/swaroopb_zephyr/zephyr-course/zephyr/soc/qemu/malta/Kconfig"
osource "F:/swaroopb_zephyr/zephyr-course/zephyr/soc/openisa/rv32m1/Kconfig"
osource "F:/swaroopb_zephyr/zephyr-course/zephyr/soc/openhwgroup/cva6/Kconfig"
osource "F:/swaroopb_zephyr/zephyr-course/zephyr/soc/oct/osd32mp15x/Kconfig"
osource "F:/swaroopb_zephyr/zephyr-course/zephyr/soc/nxp/s32/Kconfig"
osource "F:/swaroopb_zephyr/zephyr-course/zephyr/soc/nxp/rw/Kconfig"
osource "F:/swaroopb_zephyr/zephyr-course/zephyr/soc/nxp/mcx/Kconfig"
osource "F:/swaroopb_zephyr/zephyr-course/zephyr/soc/nxp/lpc/Kconfig"
osource "F:/swaroopb_zephyr/zephyr-course/zephyr/soc/nxp/layerscape/Kconfig"
osource "F:/swaroopb_zephyr/zephyr-course/zephyr/soc/nxp/kinetis/Kconfig"
osource "F:/swaroopb_zephyr/zephyr-course/zephyr/soc/nxp/imxrt/Kconfig"
osource "F:/swaroopb_zephyr/zephyr-course/zephyr/soc/nxp/imx/Kconfig"
osource "F:/swaroopb_zephyr/zephyr-course/zephyr/soc/nuvoton/numicro/Kconfig"
osource "F:/swaroopb_zephyr/zephyr-course/zephyr/soc/nuvoton/numaker/Kconfig"
osource "F:/swaroopb_zephyr/zephyr-course/zephyr/soc/nuvoton/npcx/Kconfig"
osource "F:/swaroopb_zephyr/zephyr-course/zephyr/soc/nuvoton/npcm/Kconfig"
osource "F:/swaroopb_zephyr/zephyr-course/zephyr/soc/nordic/Kconfig"
osource "F:/swaroopb_zephyr/zephyr-course/zephyr/soc/neorv32/Kconfig"
osource "F:/swaroopb_zephyr/zephyr-course/zephyr/soc/native/inf_clock/Kconfig"
osource "F:/swaroopb_zephyr/zephyr-course/zephyr/soc/microchip/sam/sama7/Kconfig"
osource "F:/swaroopb_zephyr/zephyr-course/zephyr/soc/microchip/sam/sam_d5x_e5x/Kconfig"
osource "F:/swaroopb_zephyr/zephyr-course/zephyr/soc/microchip/pic64/Kconfig"
osource "F:/swaroopb_zephyr/zephyr-course/zephyr/soc/microchip/pic32c/pic32cz_ca/Kconfig"
osource "F:/swaroopb_zephyr/zephyr-course/zephyr/soc/microchip/pic32c/pic32cx_sg/Kconfig"
osource "F:/swaroopb_zephyr/zephyr-course/zephyr/soc/microchip/pic32c/pic32cm_pl/Kconfig"
osource "F:/swaroopb_zephyr/zephyr-course/zephyr/soc/microchip/pic32c/pic32cm_jh/Kconfig"
osource "F:/swaroopb_zephyr/zephyr-course/zephyr/soc/microchip/miv/Kconfig"
osource "F:/swaroopb_zephyr/zephyr-course/zephyr/soc/microchip/mec/Kconfig"
osource "F:/swaroopb_zephyr/zephyr-course/zephyr/soc/mediatek/mt8xxx/Kconfig"
osource "F:/swaroopb_zephyr/zephyr-course/zephyr/soc/lowrisc/opentitan/Kconfig"
osource "F:/swaroopb_zephyr/zephyr-course/zephyr/soc/litex/litex_vexriscv/Kconfig"
osource "F:/swaroopb_zephyr/zephyr-course/zephyr/soc/ite/ec/Kconfig"
osource "F:/swaroopb_zephyr/zephyr-course/zephyr/soc/intel/wildcat_lake/Kconfig"
osource "F:/swaroopb_zephyr/zephyr-course/zephyr/soc/intel/raptor_lake/Kconfig"
osource "F:/swaroopb_zephyr/zephyr-course/zephyr/soc/intel/panther_lake/Kconfig"
osource "F:/swaroopb_zephyr/zephyr-course/zephyr/soc/intel/lakemont/Kconfig"
osource "F:/swaroopb_zephyr/zephyr-course/zephyr/soc/intel/intel_socfpga_std/Kconfig"
osource "F:/swaroopb_zephyr/zephyr-course/zephyr/soc/intel/intel_socfpga/Kconfig"
osource "F:/swaroopb_zephyr/zephyr-course/zephyr/soc/intel/intel_niosv/Kconfig"
osource "F:/swaroopb_zephyr/zephyr-course/zephyr/soc/intel/intel_ish/Kconfig"
osource "F:/swaroopb_zephyr/zephyr-course/zephyr/soc/intel/intel_adsp/Kconfig"
osource "F:/swaroopb_zephyr/zephyr-course/zephyr/soc/intel/elkhart_lake/Kconfig"
osource "F:/swaroopb_zephyr/zephyr-course/zephyr/soc/intel/atom/Kconfig"
osource "F:/swaroopb_zephyr/zephyr-course/zephyr/soc/intel/apollo_lake/Kconfig"
osource "F:/swaroopb_zephyr/zephyr-course/zephyr/soc/intel/alder_lake/Kconfig"
osource "F:/swaroopb_zephyr/zephyr-course/zephyr/soc/infineon/psoc4/Kconfig"
osource "F:/swaroopb_zephyr/zephyr-course/zephyr/soc/infineon/edge/Kconfig"
osource "F:/swaroopb_zephyr/zephyr-course/zephyr/soc/infineon/cat3/Kconfig"
osource "F:/swaroopb_zephyr/zephyr-course/zephyr/soc/infineon/cat1c/Kconfig"
osource "F:/swaroopb_zephyr/zephyr-course/zephyr/soc/infineon/cat1b/Kconfig"
osource "F:/swaroopb_zephyr/zephyr-course/zephyr/soc/infineon/cat1a/Kconfig"
osource "F:/swaroopb_zephyr/zephyr-course/zephyr/soc/gd/gd32/Kconfig"
osource "F:/swaroopb_zephyr/zephyr-course/zephyr/soc/gaisler/leon3/Kconfig"
osource "F:/swaroopb_zephyr/zephyr-course/zephyr/soc/gaisler/gr716a/Kconfig"
osource "F:/swaroopb_zephyr/zephyr-course/zephyr/soc/focaltech/Kconfig"
osource "F:/swaroopb_zephyr/zephyr-course/zephyr/soc/espressif/Kconfig"
osource "F:/swaroopb_zephyr/zephyr-course/zephyr/soc/ene/kb1200/Kconfig"
osource "F:/swaroopb_zephyr/zephyr-course/zephyr/soc/ene/kb106x/Kconfig"
osource "F:/swaroopb_zephyr/zephyr-course/zephyr/soc/elan/em32f967/Kconfig"
osource "F:/swaroopb_zephyr/zephyr-course/zephyr/soc/egis/Kconfig"
osource "F:/swaroopb_zephyr/zephyr-course/zephyr/soc/efinix/sapphire/Kconfig"
osource "F:/swaroopb_zephyr/zephyr-course/zephyr/soc/cdns/xtensa_sample_controller/Kconfig"
osource "F:/swaroopb_zephyr/zephyr-course/zephyr/soc/cdns/swerv/Kconfig"
osource "F:/swaroopb_zephyr/zephyr-course/zephyr/soc/cdns/sample_controller32/Kconfig"
osource "F:/swaroopb_zephyr/zephyr-course/zephyr/soc/cdns/dc233c/Kconfig"
osource "F:/swaroopb_zephyr/zephyr-course/zephyr/soc/brcm/bcmvk/Kconfig"
osource "F:/swaroopb_zephyr/zephyr-course/zephyr/soc/brcm/bcm2712/Kconfig"
osource "F:/swaroopb_zephyr/zephyr-course/zephyr/soc/brcm/bcm2711/Kconfig"
osource "F:/swaroopb_zephyr/zephyr-course/zephyr/soc/blackberry/qnxhv_vm/Kconfig"
osource "F:/swaroopb_zephyr/zephyr-course/zephyr/soc/bflb/Kconfig"
osource "F:/swaroopb_zephyr/zephyr-course/zephyr/soc/atmel/sam0/Kconfig"
osource "F:/swaroopb_zephyr/zephyr-course/zephyr/soc/atmel/sam/Kconfig"
osource "F:/swaroopb_zephyr/zephyr-course/zephyr/soc/aspeed/Kconfig"
osource "F:/swaroopb_zephyr/zephyr-course/zephyr/soc/arm/Kconfig"
osource "F:/swaroopb_zephyr/zephyr-course/zephyr/soc/arm/beetle/Kconfig"
osource "F:/swaroopb_zephyr/zephyr-course/zephyr/soc/antmicro/myra/Kconfig"
osource "F:/swaroopb_zephyr/zephyr-course/zephyr/soc/andestech/Kconfig"
osource "F:/swaroopb_zephyr/zephyr-course/zephyr/soc/amd/acp_6_0/Kconfig"
osource "F:/swaroopb_zephyr/zephyr-course/zephyr/soc/ambiq/Kconfig"
osource "F:/swaroopb_zephyr/zephyr-course/zephyr/soc/allwinner/sun8i_h3/Kconfig"
osource "F:/swaroopb_zephyr/zephyr-course/zephyr/soc/alif/ensemble/Kconfig"
osource "F:/swaroopb_zephyr/zephyr-course/zephyr/soc/aesc/Kconfig"
osource "F:/swaroopb_zephyr/zephyr-course/zephyr/soc/adi/max32/Kconfig"
```
