## twister-out.5/qemu_x86_atom/zephyr_gnu/tests/ring_buf/homework.unit.ring_buf/Kconfig/soc/Kconfig.sysbuild
```kconfig
# Load Sysbuild SoC Kconfig descriptions.
osource "F:/swaroopb_zephyr/zephyr-course/zephyr/soc/xlnx/zynqmp/Kconfig.sysbuild"
osource "F:/swaroopb_zephyr/zephyr-course/zephyr/soc/xlnx/zynq7000/Kconfig.sysbuild"
osource "F:/swaroopb_zephyr/zephyr-course/zephyr/soc/xlnx/versalnet/Kconfig.sysbuild"
osource "F:/swaroopb_zephyr/zephyr-course/zephyr/soc/xlnx/versal2/Kconfig.sysbuild"
osource "F:/swaroopb_zephyr/zephyr-course/zephyr/soc/xlnx/versal/Kconfig.sysbuild"
osource "F:/swaroopb_zephyr/zephyr-course/zephyr/soc/xen/Kconfig.sysbuild"
osource "F:/swaroopb_zephyr/zephyr-course/zephyr/soc/wch/ch32v/Kconfig.sysbuild"
osource "F:/swaroopb_zephyr/zephyr-course/zephyr/soc/ti/simplelink/Kconfig.sysbuild"
osource "F:/swaroopb_zephyr/zephyr-course/zephyr/soc/ti/mspm0/Kconfig.sysbuild"
osource "F:/swaroopb_zephyr/zephyr-course/zephyr/soc/ti/lm3s6965/Kconfig.sysbuild"
osource "F:/swaroopb_zephyr/zephyr-course/zephyr/soc/ti/k3/Kconfig.sysbuild"
osource "F:/swaroopb_zephyr/zephyr-course/zephyr/soc/telink/tlsr/Kconfig.sysbuild"
osource "F:/swaroopb_zephyr/zephyr-course/zephyr/soc/syna/sr100/Kconfig.sysbuild"
osource "F:/swaroopb_zephyr/zephyr-course/zephyr/soc/starfive/jh71xx/Kconfig.sysbuild"
osource "F:/swaroopb_zephyr/zephyr-course/zephyr/soc/st/stm32/Kconfig.sysbuild"
osource "F:/swaroopb_zephyr/zephyr-course/zephyr/soc/snps/qemu_arc/Kconfig.sysbuild"
osource "F:/swaroopb_zephyr/zephyr-course/zephyr/soc/snps/nsim/arc_v/Kconfig.sysbuild"
osource "F:/swaroopb_zephyr/zephyr-course/zephyr/soc/snps/nsim/arc_classic/Kconfig.sysbuild"
osource "F:/swaroopb_zephyr/zephyr-course/zephyr/soc/snps/hsdk4xd/Kconfig.sysbuild"
osource "F:/swaroopb_zephyr/zephyr-course/zephyr/soc/snps/hsdk/Kconfig.sysbuild"
osource "F:/swaroopb_zephyr/zephyr-course/zephyr/soc/snps/emsk/Kconfig.sysbuild"
osource "F:/swaroopb_zephyr/zephyr-course/zephyr/soc/snps/emsdp/Kconfig.sysbuild"
osource "F:/swaroopb_zephyr/zephyr-course/zephyr/soc/snps/arc_iot/Kconfig.sysbuild"
osource "F:/swaroopb_zephyr/zephyr-course/zephyr/soc/silabs/Kconfig.sysbuild"
osource "F:/swaroopb_zephyr/zephyr-course/zephyr/soc/sifli/sf32/Kconfig.sysbuild"
osource "F:/swaroopb_zephyr/zephyr-course/zephyr/soc/sifive/sifive_freedom/Kconfig.sysbuild"
osource "F:/swaroopb_zephyr/zephyr-course/zephyr/soc/sensry/Kconfig.sysbuild"
osource "F:/swaroopb_zephyr/zephyr-course/zephyr/soc/rockchip/Kconfig.sysbuild"
osource "F:/swaroopb_zephyr/zephyr-course/zephyr/soc/renode/riscv_virtual/Kconfig.sysbuild"
osource "F:/swaroopb_zephyr/zephyr-course/zephyr/soc/renode/cortex_r8_virtual/Kconfig.sysbuild"
osource "F:/swaroopb_zephyr/zephyr-course/zephyr/soc/renesas/smartbond/Kconfig.sysbuild"
osource "F:/swaroopb_zephyr/zephyr-course/zephyr/soc/renesas/rz/Kconfig.sysbuild"
osource "F:/swaroopb_zephyr/zephyr-course/zephyr/soc/renesas/rx/Kconfig.sysbuild"
osource "F:/swaroopb_zephyr/zephyr-course/zephyr/soc/renesas/rcar/Kconfig.sysbuild"
osource "F:/swaroopb_zephyr/zephyr-course/zephyr/soc/renesas/ra/Kconfig.sysbuild"
osource "F:/swaroopb_zephyr/zephyr-course/zephyr/soc/realtek/fingerprint/Kconfig.sysbuild"
osource "F:/swaroopb_zephyr/zephyr-course/zephyr/soc/realtek/ec/Kconfig.sysbuild"
osource "F:/swaroopb_zephyr/zephyr-course/zephyr/soc/realtek/bee/Kconfig.sysbuild"
osource "F:/swaroopb_zephyr/zephyr-course/zephyr/soc/realtek/ameba/Kconfig.sysbuild"
osource "F:/swaroopb_zephyr/zephyr-course/zephyr/soc/raspberrypi/rpi_pico/Kconfig.sysbuild"
osource "F:/swaroopb_zephyr/zephyr-course/zephyr/soc/quicklogic/eos_s3/Kconfig.sysbuild"
osource "F:/swaroopb_zephyr/zephyr-course/zephyr/soc/qemu/virt_riscv/Kconfig.sysbuild"
osource "F:/swaroopb_zephyr/zephyr-course/zephyr/soc/qemu/or1k/Kconfig.sysbuild"
osource "F:/swaroopb_zephyr/zephyr-course/zephyr/soc/qemu/malta/Kconfig.sysbuild"
osource "F:/swaroopb_zephyr/zephyr-course/zephyr/soc/openisa/rv32m1/Kconfig.sysbuild"
osource "F:/swaroopb_zephyr/zephyr-course/zephyr/soc/openhwgroup/cva6/Kconfig.sysbuild"
osource "F:/swaroopb_zephyr/zephyr-course/zephyr/soc/oct/osd32mp15x/Kconfig.sysbuild"
osource "F:/swaroopb_zephyr/zephyr-course/zephyr/soc/nxp/s32/Kconfig.sysbuild"
osource "F:/swaroopb_zephyr/zephyr-course/zephyr/soc/nxp/rw/Kconfig.sysbuild"
osource "F:/swaroopb_zephyr/zephyr-course/zephyr/soc/nxp/mcx/Kconfig.sysbuild"
osource "F:/swaroopb_zephyr/zephyr-course/zephyr/soc/nxp/lpc/Kconfig.sysbuild"
osource "F:/swaroopb_zephyr/zephyr-course/zephyr/soc/nxp/layerscape/Kconfig.sysbuild"
osource "F:/swaroopb_zephyr/zephyr-course/zephyr/soc/nxp/kinetis/Kconfig.sysbuild"
osource "F:/swaroopb_zephyr/zephyr-course/zephyr/soc/nxp/imxrt/Kconfig.sysbuild"
osource "F:/swaroopb_zephyr/zephyr-course/zephyr/soc/nxp/imx/Kconfig.sysbuild"
osource "F:/swaroopb_zephyr/zephyr-course/zephyr/soc/nuvoton/numicro/Kconfig.sysbuild"
osource "F:/swaroopb_zephyr/zephyr-course/zephyr/soc/nuvoton/numaker/Kconfig.sysbuild"
osource "F:/swaroopb_zephyr/zephyr-course/zephyr/soc/nuvoton/npcx/Kconfig.sysbuild"
osource "F:/swaroopb_zephyr/zephyr-course/zephyr/soc/nuvoton/npcm/Kconfig.sysbuild"
osource "F:/swaroopb_zephyr/zephyr-course/zephyr/soc/nordic/Kconfig.sysbuild"
osource "F:/swaroopb_zephyr/zephyr-course/zephyr/soc/neorv32/Kconfig.sysbuild"
osource "F:/swaroopb_zephyr/zephyr-course/zephyr/soc/native/inf_clock/Kconfig.sysbuild"
osource "F:/swaroopb_zephyr/zephyr-course/zephyr/soc/microchip/sam/sama7/Kconfig.sysbuild"
osource "F:/swaroopb_zephyr/zephyr-course/zephyr/soc/microchip/sam/sam_d5x_e5x/Kconfig.sysbuild"
osource "F:/swaroopb_zephyr/zephyr-course/zephyr/soc/microchip/pic64/Kconfig.sysbuild"
osource "F:/swaroopb_zephyr/zephyr-course/zephyr/soc/microchip/pic32c/pic32cz_ca/Kconfig.sysbuild"
osource "F:/swaroopb_zephyr/zephyr-course/zephyr/soc/microchip/pic32c/pic32cx_sg/Kconfig.sysbuild"
osource "F:/swaroopb_zephyr/zephyr-course/zephyr/soc/microchip/pic32c/pic32cm_pl/Kconfig.sysbuild"
osource "F:/swaroopb_zephyr/zephyr-course/zephyr/soc/microchip/pic32c/pic32cm_jh/Kconfig.sysbuild"
osource "F:/swaroopb_zephyr/zephyr-course/zephyr/soc/microchip/miv/Kconfig.sysbuild"
osource "F:/swaroopb_zephyr/zephyr-course/zephyr/soc/microchip/mec/Kconfig.sysbuild"
osource "F:/swaroopb_zephyr/zephyr-course/zephyr/soc/mediatek/mt8xxx/Kconfig.sysbuild"
osource "F:/swaroopb_zephyr/zephyr-course/zephyr/soc/lowrisc/opentitan/Kconfig.sysbuild"
osource "F:/swaroopb_zephyr/zephyr-course/zephyr/soc/litex/litex_vexriscv/Kconfig.sysbuild"
osource "F:/swaroopb_zephyr/zephyr-course/zephyr/soc/ite/ec/Kconfig.sysbuild"
osource "F:/swaroopb_zephyr/zephyr-course/zephyr/soc/intel/wildcat_lake/Kconfig.sysbuild"
osource "F:/swaroopb_zephyr/zephyr-course/zephyr/soc/intel/raptor_lake/Kconfig.sysbuild"
osource "F:/swaroopb_zephyr/zephyr-course/zephyr/soc/intel/panther_lake/Kconfig.sysbuild"
osource "F:/swaroopb_zephyr/zephyr-course/zephyr/soc/intel/lakemont/Kconfig.sysbuild"
osource "F:/swaroopb_zephyr/zephyr-course/zephyr/soc/intel/intel_socfpga_std/Kconfig.sysbuild"
osource "F:/swaroopb_zephyr/zephyr-course/zephyr/soc/intel/intel_socfpga/Kconfig.sysbuild"
osource "F:/swaroopb_zephyr/zephyr-course/zephyr/soc/intel/intel_niosv/Kconfig.sysbuild"
osource "F:/swaroopb_zephyr/zephyr-course/zephyr/soc/intel/intel_ish/Kconfig.sysbuild"
osource "F:/swaroopb_zephyr/zephyr-course/zephyr/soc/intel/intel_adsp/Kconfig.sysbuild"
osource "F:/swaroopb_zephyr/zephyr-course/zephyr/soc/intel/elkhart_lake/Kconfig.sysbuild"
osource "F:/swaroopb_zephyr/zephyr-course/zephyr/soc/intel/atom/Kconfig.sysbuild"
osource "F:/swaroopb_zephyr/zephyr-course/zephyr/soc/intel/apollo_lake/Kconfig.sysbuild"
osource "F:/swaroopb_zephyr/zephyr-course/zephyr/soc/intel/alder_lake/Kconfig.sysbuild"
osource "F:/swaroopb_zephyr/zephyr-course/zephyr/soc/infineon/psoc4/Kconfig.sysbuild"
osource "F:/swaroopb_zephyr/zephyr-course/zephyr/soc/infineon/edge/Kconfig.sysbuild"
osource "F:/swaroopb_zephyr/zephyr-course/zephyr/soc/infineon/cat3/Kconfig.sysbuild"
osource "F:/swaroopb_zephyr/zephyr-course/zephyr/soc/infineon/cat1c/Kconfig.sysbuild"
osource "F:/swaroopb_zephyr/zephyr-course/zephyr/soc/infineon/cat1b/Kconfig.sysbuild"
osource "F:/swaroopb_zephyr/zephyr-course/zephyr/soc/infineon/cat1a/Kconfig.sysbuild"
osource "F:/swaroopb_zephyr/zephyr-course/zephyr/soc/gd/gd32/Kconfig.sysbuild"
osource "F:/swaroopb_zephyr/zephyr-course/zephyr/soc/gaisler/leon3/Kconfig.sysbuild"
osource "F:/swaroopb_zephyr/zephyr-course/zephyr/soc/gaisler/gr716a/Kconfig.sysbuild"
osource "F:/swaroopb_zephyr/zephyr-course/zephyr/soc/focaltech/Kconfig.sysbuild"
osource "F:/swaroopb_zephyr/zephyr-course/zephyr/soc/espressif/Kconfig.sysbuild"
osource "F:/swaroopb_zephyr/zephyr-course/zephyr/soc/ene/kb1200/Kconfig.sysbuild"
osource "F:/swaroopb_zephyr/zephyr-course/zephyr/soc/ene/kb106x/Kconfig.sysbuild"
osource "F:/swaroopb_zephyr/zephyr-course/zephyr/soc/elan/em32f967/Kconfig.sysbuild"
osource "F:/swaroopb_zephyr/zephyr-course/zephyr/soc/egis/Kconfig.sysbuild"
osource "F:/swaroopb_zephyr/zephyr-course/zephyr/soc/efinix/sapphire/Kconfig.sysbuild"
osource "F:/swaroopb_zephyr/zephyr-course/zephyr/soc/cdns/xtensa_sample_controller/Kconfig.sysbuild"
osource "F:/swaroopb_zephyr/zephyr-course/zephyr/soc/cdns/swerv/Kconfig.sysbuild"
osource "F:/swaroopb_zephyr/zephyr-course/zephyr/soc/cdns/sample_controller32/Kconfig.sysbuild"
osource "F:/swaroopb_zephyr/zephyr-course/zephyr/soc/cdns/dc233c/Kconfig.sysbuild"
osource "F:/swaroopb_zephyr/zephyr-course/zephyr/soc/brcm/bcmvk/Kconfig.sysbuild"
osource "F:/swaroopb_zephyr/zephyr-course/zephyr/soc/brcm/bcm2712/Kconfig.sysbuild"
osource "F:/swaroopb_zephyr/zephyr-course/zephyr/soc/brcm/bcm2711/Kconfig.sysbuild"
osource "F:/swaroopb_zephyr/zephyr-course/zephyr/soc/blackberry/qnxhv_vm/Kconfig.sysbuild"
osource "F:/swaroopb_zephyr/zephyr-course/zephyr/soc/bflb/Kconfig.sysbuild"
osource "F:/swaroopb_zephyr/zephyr-course/zephyr/soc/atmel/sam0/Kconfig.sysbuild"
osource "F:/swaroopb_zephyr/zephyr-course/zephyr/soc/atmel/sam/Kconfig.sysbuild"
osource "F:/swaroopb_zephyr/zephyr-course/zephyr/soc/aspeed/Kconfig.sysbuild"
osource "F:/swaroopb_zephyr/zephyr-course/zephyr/soc/arm/Kconfig.sysbuild"
osource "F:/swaroopb_zephyr/zephyr-course/zephyr/soc/arm/beetle/Kconfig.sysbuild"
osource "F:/swaroopb_zephyr/zephyr-course/zephyr/soc/antmicro/myra/Kconfig.sysbuild"
osource "F:/swaroopb_zephyr/zephyr-course/zephyr/soc/andestech/Kconfig.sysbuild"
osource "F:/swaroopb_zephyr/zephyr-course/zephyr/soc/amd/acp_6_0/Kconfig.sysbuild"
osource "F:/swaroopb_zephyr/zephyr-course/zephyr/soc/ambiq/Kconfig.sysbuild"
osource "F:/swaroopb_zephyr/zephyr-course/zephyr/soc/allwinner/sun8i_h3/Kconfig.sysbuild"
osource "F:/swaroopb_zephyr/zephyr-course/zephyr/soc/alif/ensemble/Kconfig.sysbuild"
osource "F:/swaroopb_zephyr/zephyr-course/zephyr/soc/aesc/Kconfig.sysbuild"
osource "F:/swaroopb_zephyr/zephyr-course/zephyr/soc/adi/max32/Kconfig.sysbuild"
```

## twister-out.6/qemu_x86_atom/zephyr_gnu/tests/ring_buf/homework.unit.ring_buf/Kconfig/boards/Kconfig.defconfig
```kconfig
# Load Zephyr board defconfig descriptions.
osource "F:/swaroopb_zephyr/zephyr-course/zephyr/boards/qemu/x86/Kconfig.defconfig"
```

## twister-out/qemu_x86_atom/zephyr_gnu/tests/ring_buf/homework.unit.ring_buf/Kconfig/arch/Kconfig
```kconfig
# Load Zephyr Arch Kconfig descriptions.
osource "F:/swaroopb_zephyr/zephyr-course/zephyr/arch/rx/Kconfig"
osource "F:/swaroopb_zephyr/zephyr-course/zephyr/arch/x86/Kconfig"
osource "F:/swaroopb_zephyr/zephyr-course/zephyr/arch/xtensa/Kconfig"
osource "F:/swaroopb_zephyr/zephyr-course/zephyr/arch/sparc/Kconfig"
osource "F:/swaroopb_zephyr/zephyr-course/zephyr/arch/riscv/Kconfig"
osource "F:/swaroopb_zephyr/zephyr-course/zephyr/arch/posix/Kconfig"
osource "F:/swaroopb_zephyr/zephyr-course/zephyr/arch/openrisc/Kconfig"
osource "F:/swaroopb_zephyr/zephyr-course/zephyr/arch/mips/Kconfig"
osource "F:/swaroopb_zephyr/zephyr-course/zephyr/arch/arm64/Kconfig"
osource "F:/swaroopb_zephyr/zephyr-course/zephyr/arch/arm/Kconfig"
osource "F:/swaroopb_zephyr/zephyr-course/zephyr/arch/arc/Kconfig"
```
